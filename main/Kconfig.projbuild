## sdkconfig.defaults.esp32
```kconfig
CONFIG_ESPTOOLPY_FLASHSIZE_4MB=y
CONFIG_PARTITION_TABLE_CUSTOM=y
CONFIG_PARTITION_TABLE_CUSTOM_FILENAME="partitions/v2/4m.csv"
CONFIG_SR_WN_WN9_NIHAOXIAOZHI_TTS=y
CONFIG_ESP_TASK_WDT_TIMEOUT_S=20

# Konfigurasi Board ESP32 DevKit
CONFIG_BOARD_TYPE_BREAD_COMPACT_ESP32=y

# OLED SSD1306 128x64 (bukan 128x32)
CONFIG_DISPLAY_OLED_TYPE=y
CONFIG_OLED_SSD1306_128X64=y

# WiFi Hotspot Mode untuk konfigurasi
CONFIG_USE_HOTSPOT_WIFI_PROVISIONING=y

# Disable auto-connect WiFi di ESP-IDF
CONFIG_ESP_WIFI_STA_DISCONNECTED_PM_ENABLE=y
CONFIG_ESP_WIFI_AUTO_CONNECT=n

# Display Mirror
CONFIG_DISPLAY_MIRROR_X=y
CONFIG_DISPLAY_MIRROR_Y=y

# Bahasa Indonesia
CONFIG_LANGUAGE_ID_ID=y

# Flash Aset Default
CONFIG_FLASH_DEFAULT_ASSETS=y
```
